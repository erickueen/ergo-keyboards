## keyboards/corne/config/corne_rgb_module/Kconfig
```kconfig
menuconfig CORNE_RGB_UNDERGLOW
    bool "Corne custom RGB underglow"
    select LED_STRIP
    select SPI
    select WS2812_STRIP
    select ZMK_LOW_PRIORITY_WORK_QUEUE

if CORNE_RGB_UNDERGLOW

config CORNE_RGB_UNDERGLOW_EXT_POWER
    bool "RGB underglow toggling also controls external power"
    select ZMK_EXT_POWER

config CORNE_RGB_UNDERGLOW_BRT_MIN
    int "RGB underglow minimum brightness in percent"
    range 0 100
    default 0

config CORNE_RGB_UNDERGLOW_BRT_MAX
    int "RGB underglow maximum brightness in percent"
    range CORNE_RGB_UNDERGLOW_BRT_MIN 100
    default 100

config CORNE_RGB_UNDERGLOW_HUE_STEP
    int "RGB underglow hue step in degrees"
    range 0 359
    default 10

config CORNE_RGB_UNDERGLOW_SAT_STEP
    int "RGB underglow saturation step in percent"
    range 0 100
    default 10

config CORNE_RGB_UNDERGLOW_BRT_STEP
    int "RGB underglow brightness step in percent"
    range 0 100
    default 10

config CORNE_RGB_UNDERGLOW_HUE_START
    int "RGB underglow start hue value in degrees"
    range 0 359
    default 0

config CORNE_RGB_UNDERGLOW_SAT_START
    int "RGB underglow start saturation value in percent"
    range 0 100
    default 100

config CORNE_RGB_UNDERGLOW_BRT_START
    int "RGB underglow start brightness value in percent"
    range CORNE_RGB_UNDERGLOW_BRT_MIN CORNE_RGB_UNDERGLOW_BRT_MAX
    default CORNE_RGB_UNDERGLOW_BRT_MAX

config CORNE_RGB_UNDERGLOW_SPD_START
    int "RGB underglow start animation speed value"
    range 1 5
    default 3

config CORNE_RGB_UNDERGLOW_EFF_START
    int "RGB underglow start effect int value related to the effect enum list"
    range 0 4
    default 0

config CORNE_RGB_UNDERGLOW_ON_START
    bool "RGB underglow starts on by default"
    default y

config CORNE_RGB_UNDERGLOW_AUTO_OFF_IDLE
    bool "Turn off RGB underglow when keyboard goes into idle state"

config CORNE_RGB_UNDERGLOW_AUTO_OFF_USB
    bool "Turn off RGB underglow when USB is disconnected"
    depends on USB_DEVICE_STACK

config CORNE_RGB_STATUS
    bool "Corne RGB status behavior"
    default y

endif # CORNE_RGB_UNDERGLOW
```

## keyboards/corne/config/corne_rgb_module/dts/bindings/behaviors/corne,behavior-rgb-status.yaml
```yaml
description: Corne RGB status overlay behavior

compatible: "corne,behavior-rgb-status"

include: zero_param.yaml
```
